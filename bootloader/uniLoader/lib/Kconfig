## bootloader/uniLoader/lib/Kconfig
```kconfig
menu "Libraries"
	config SIMPLE_FB
		bool "Support for Simple Framebuffer"
		default y
		help
		  Say Y if you want to have Framebuffer output.

	config SIMPLE_FB_PRESERVE_CONTENTS
		bool "Preserve firmware framebuffer until the first console message"
		depends on SIMPLE_FB
		default n
		help
		  Keep the firmware artwork during a quiet boot. Clear it before
		  the first visible message so errors remain readable.

	config EARLYCON
		bool "Support for UART early console"
		default n
		help
		  Say Y if you want to have UART early console output. Keep
		  in mind that your board files need to provide uart_puts
		  functionality in order for this to work.

	config LIBFDT
		bool "Support for libfdt"
		default y
		help
		  Say Y if you want to have libfdt features.

	config FDT_BUF_SIZE
		int "Size of the static buffer for the Flattened Device Tree"
		default 500000
		depends on LIBFDT
		help
		  This option specifies the size (in bytes) of the buffer used for DTB modifying. The default value of 500 KB should be sufficient even for downstream device trees.
endmenu
```

## src/cpuidle/Kconfig
```kconfig
# SPDX-License-Identifier: GPL-2.0
config S9PLUS_CPUIDLE
	bool "Samsung Galaxy S9+ A55 CPU idle and MCT broadcast"
	depends on ARM64 && ARCH_EXYNOS && ARM_PSCI_FW && CPU_IDLE && CPU_PM
	depends on SMP && GENERIC_CLOCKEVENTS_BROADCAST
	select CPU_IDLE_MULTIPLE_DRIVERS
	help
	  Board-specific legacy PSCI core powerdown for validated A55 CPUs 2/3,
	  with a hardware MCT broadcast clockevent. Requires the star2lte suspend
	  affinity correction. C2 is disabled initially; enable through the
	  standard cpuidle sysfs interface after checking persistent boot guards.
	  No cluster powerdown or system suspend support is provided.
```
